## Firmware/custom_shields/SENSEI_ExGShield/Kconfig.shield
```kconfig
# Copyright (c) 2019 Linaro Limited
# SPDX-License-Identifier: Apache-2.0

config SHIELD_SENSEI_EXGSHIELD 
	def_bool $(shields_list_contains,SENSEI_ExGShield)
```

## Firmware/custom_shields/SENSEI_ExGShield/SENSEI_ExGShield.defconfig
```kconfig
# Copyright (c) 2024 Nordic Semiconductor ASA
# SPDX-License-Identifier: Apache-2.0

CONFIG_GPIO_PCA64XXA=n
CONFIG_BME680=n


CONFIG_TFM_SECURE_UART=n
CONFIG_TFM_LOG_LEVEL_SILENCE=y
```

## Firmware/custom_shields/SENSEI_PPGShield/Kconfig.shield
```kconfig
# Copyright (c) 2019 Linaro Limited
# SPDX-License-Identifier: Apache-2.0

config SHIELD_SENSEI_PPGSHIELD 
	def_bool $(shields_list_contains,SENSEI_PPGShield)
```
